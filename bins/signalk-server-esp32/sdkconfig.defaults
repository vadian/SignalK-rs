## bins/signalk-server-esp32/sdkconfig.defaults
```kconfig
# SignalK ESP32 Server - ESP-IDF Configuration
#
# WARNING: This file is NOT used by esp-idf-sys!
# The workspace root's sdkconfig.defaults is used instead.
# This file is kept for reference only.
# See README.md for details on the sdkconfig.defaults location issue.

# Stack sizes - Rust needs more than C defaults
# Main task stack (default is 3KB, Rust needs ~16KB for JSON serialization)
CONFIG_ESP_MAIN_TASK_STACK_SIZE=16384
# Minimum pthread stack (threads spawned with std::thread::Builder must be >= this)
CONFIG_PTHREAD_STACK_MIN=16384

# Stack overflow detection (useful for debugging)
CONFIG_FREERTOS_CHECK_STACKOVERFLOW=2
CONFIG_FREERTOS_WATCHPOINT_END_OF_STACK=y

# FreeRTOS tick frequency - 100 Hz by default (10ms granularity)
# Uncomment for 1ms granularity if needed for precise timing
#CONFIG_FREERTOS_HZ=1000

# WiFi configuration
CONFIG_ESP_WIFI_STATIC_RX_BUFFER_NUM=10
CONFIG_ESP_WIFI_DYNAMIC_RX_BUFFER_NUM=32
CONFIG_ESP_WIFI_DYNAMIC_TX_BUFFER_NUM=32

# HTTP server configuration
CONFIG_HTTPD_MAX_REQ_HDR_LEN=1024
CONFIG_HTTPD_MAX_URI_LEN=512

# WebSocket support (required for SignalK streaming)
CONFIG_HTTPD_WS_SUPPORT=y
CONFIG_WS_TRANSPORT=y
CONFIG_WS_BUFFER_SIZE=1024

# Increase LWIP socket count for multiple WebSocket connections
CONFIG_LWIP_MAX_SOCKETS=16

# Enable mDNS for service discovery (future use)
CONFIG_MDNS_MAX_SERVICES=10
```

## sdkconfig.defaults.dev
```kconfig
# Development configuration
# - Large partition for binaries (3MB)
# - Full debugging support (INFO logging)
# - Size-optimized to fit in ESP32 IRAM
#
# Usage: Default for `cargo build` from bins/signalk-server-esp32/

# Use 3MB single partition (no OTA)
# Note: Path is relative to esp-idf-sys build output dir (target/.../build/esp-idf-sys-.../out/)
# Goes up 8 levels to workspace root: out -> esp-idf-sys-* -> build -> debug -> xtensa-esp32-espidf -> target -> signalk-server-esp32 -> bins -> [root]
CONFIG_PARTITION_TABLE_CUSTOM=y
CONFIG_PARTITION_TABLE_CUSTOM_FILENAME="../../../../../../../../partitions.dev.csv"

# Optimize for size (required to fit in ESP32 IRAM segment)
CONFIG_COMPILER_OPTIMIZATION_SIZE=y

# Full logging for debugging
CONFIG_LOG_DEFAULT_LEVEL_INFO=y

# Disable unused components to speed up builds
CONFIG_ETH_ENABLED=n
CONFIG_MQTT_ENABLE=n
CONFIG_FATFS_ENABLED=n
```

## sdkconfig.defaults.release
```kconfig
# Production configuration
# - OTA-compatible partition layout (2x 1.5MB)
# - Size optimizations (-Os)
# - Reduced logging
#
# Usage: ESP_IDF_SDKCONFIG_DEFAULTS="../../sdkconfig.defaults;../../sdkconfig.defaults.release" cargo build --release

# Use OTA partition layout
# Note: Path is relative to esp-idf-sys build output dir (target/.../build/esp-idf-sys-.../out/)
# Goes up 8 levels to workspace root: out -> esp-idf-sys-* -> build -> debug -> xtensa-esp32-espidf -> target -> signalk-server-esp32 -> bins -> [root]
CONFIG_PARTITION_TABLE_CUSTOM=y
CONFIG_PARTITION_TABLE_CUSTOM_FILENAME="../../../../../../../../partitions.release.csv"

# Optimize for size
CONFIG_COMPILER_OPTIMIZATION_SIZE=y
CONFIG_COMPILER_CXX_EXCEPTIONS=n
CONFIG_COMPILER_CXX_RTTI=n

# Reduce logging (WARN level)
CONFIG_LOG_DEFAULT_LEVEL_WARN=y

# Disable unused components
CONFIG_ETH_ENABLED=n
CONFIG_MQTT_ENABLE=n
CONFIG_FATFS_ENABLED=n
CONFIG_ESP_DRIVER_MCPWM_ENABLED=n
CONFIG_LCD_ENABLE=n
CONFIG_SDMMC_ENABLED=n
CONFIG_I2S_ENABLE=n
```
